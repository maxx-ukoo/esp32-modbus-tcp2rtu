## sdkconfig.defaults
```kconfig
CONFIG_ESP_NETIF_TCPIP_ADAPTER_COMPATIBLE_LAYER=n
CONFIG_ESP_HTTPS_SERVER_ENABLE=y
CONFIG_HTTPD_MAX_REQ_HDR_LEN=1024
CONFIG_SPIFFS_OBJ_NAME_LEN=64
CONFIG_FATFS_LONG_FILENAME=y
CONFIG_FATFS_LFN_HEAP=y
CONFIG_ESPTOOLPY_FLASHSIZE_4MB=y
CONFIG_PARTITION_TABLE_CUSTOM=y
CONFIG_PARTITION_TABLE_CUSTOM_FILENAME="partitions.csv"
CONFIG_PARTITION_TABLE_FILENAME="partitions.csv"
CONFIG_PARTITION_TABLE_OFFSET="0x10000"
CONFIG_EXAMPLE_WEB_MOUNT_POINT="/www"
CONFIG_EXAMPLE_WEB_DEPLOY_SF=y
CONFIG_EXAMPLE_ETH_PHY_ADDR=0
CONFIG_EXAMPLE_ETH_PHY_LAN8720=y
CONFIG_EXAMPLE_ETH_MDC_GPIO=16
CONFIG_EXAMPLE_ETH_MDIO_GPIO=17
CONFIG_EXAMPLE_ETH_PHY_RST_GPIO=0
CONFIG_EXAMPLE_ETH_PHY_ADDR=0
CONFIG_FMB_MASTER_TIMEOUT_MS_RESPOND=350
```
